## firmware/main/Kconfig.projbuild
```kconfig
menu "desk-buddy"

    config BUDDY_WIFI_SSID
        string "Wi-Fi SSID"
        default ""

    config BUDDY_WIFI_PASSWORD
        string "Wi-Fi password"
        default ""

    config BUDDY_TZ
        string "Timezone (POSIX TZ string)"
        default "<-03>3"
        help
            America/Sao_Paulo is "<-03>3" (UTC-3, no daylight saving).
            The weather location is set on the buddy.local page.

endmenu
```
